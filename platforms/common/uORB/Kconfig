## platforms/common/uORB/Kconfig
```kconfig
menuconfig ORB_COMMUNICATOR
	bool "orb communicator"
	default n
	depends on PLATFORM_QURT || PLATFORM_POSIX || PLATFORM_NUTTX
	---help---
		Enable support for the uorb communicator for distributed platforms
```

## src/modules/rpmsg_uorb/Kconfig
```kconfig
menuconfig MODULES_RPMSG_UORB
	bool "rpmsg_uorb"
	default n
	depends on BOARD_RPMSG && ORB_COMMUNICATOR
	---help---
		uORB bridge to a remote core over rpmsg (NuttX rptun): remote
		subscriptions and publications on a "rpmsg-uorb" endpoint.
```
